#include <dt-bindings/gpio/gpio.h>
#include "pereda.dtsi"

/ {
    kscan0: kscan0 {
        compatible = "zmk,kscan-gpio-matrix";
        diode-direction = "col2row";

    row-gpios =
        <&gpio0 28 (GPIO_ACTIVE_HIGH | GPIO_PULL_DOWN)>,
        <&gpio0 5  (GPIO_ACTIVE_HIGH | GPIO_PULL_DOWN)>,
        <&gpio1 11 (GPIO_ACTIVE_HIGH | GPIO_PULL_DOWN)>,
        <&gpio1 14 (GPIO_ACTIVE_HIGH | GPIO_PULL_DOWN)>;

    col-gpios =
        <&gpio0 2  GPIO_ACTIVE_HIGH>,
        <&gpio0 3  GPIO_ACTIVE_HIGH>,
        <&gpio0 4  GPIO_ACTIVE_HIGH>,
        <&gpio1 12 GPIO_ACTIVE_HIGH>,
        <&gpio1 13 GPIO_ACTIVE_HIGH>,
        <&gpio0 29 GPIO_ACTIVE_HIGH>;
    };

    chosen {
        zmk,kscan = &kscan0;
        zmk,physical-layout = &pereda;
    };
};

